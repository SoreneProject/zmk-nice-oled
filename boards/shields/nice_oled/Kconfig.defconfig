## boards/shields/nice_oled/Kconfig.defconfig
```kconfig
config NICE_EPAPER_ON
    bool "Enable nice view widget compatibility"
    default n

if !NICE_EPAPER_ON

if SHIELD_NICE_OLED

config LV_Z_VDB_SIZE
    default 64 if SHIELD_NICE_OLED
    # default 100 if !SHIELD_NICE_OLED

config LV_DPI_DEF
    default 148 if SHIELD_NICE_OLED
    # default 161 if !SHIELD_NICE_OLED

config LV_Z_BITS_PER_PIXEL
    default 1

choice LV_COLOR_DEPTH
    default LV_COLOR_DEPTH_1
endchoice

choice ZMK_DISPLAY_WORK_QUEUE
    default ZMK_DISPLAY_WORK_QUEUE_DEDICATED
endchoice

choice ZMK_DISPLAY_STATUS_SCREEN
    default ZMK_DISPLAY_STATUS_SCREEN_CUSTOM
endchoice

config LV_Z_MEM_POOL_SIZE
    default 4096 if ZMK_DISPLAY_STATUS_SCREEN_CUSTOM

config ZMK_DISPLAY_STATUS_SCREEN_CUSTOM
    imply NICE_VIEW_WIDGET_STATUS

config NICE_OLED_GEM_ANIMATION_WPM_FIXED_RANGE
    bool "Enable fixed range for WPM gauge/chart"
    default y

config NICE_OLED_GEM_ANIMATION_WPM_FIXED_RANGE_MAX
    int "Fixed range maximum for WPM gauge/chart"
    default 100

config NICE_OLED_GEM_ANIMATION
    bool "Enable animation on peripheral"
    default y

config NICE_OLED_GEM_ANIMATION_SMART_BATTERY
    bool "Enable animation on peripheral VERY EXPERIMENTAL!!"
    default n

config NICE_OLED_GEM_ANIMATION_MS
    int "Animation length in milliseconds"
    default 960

config NICE_OLED_POKEMON_ANIMATION
    bool "Enable animation on peripheral"
    default n

config NICE_OLED_POKEMON_ANIMATION_MS
    int "Animation length in milliseconds"
    default 4800

config NICE_OLED_VIM
    bool "Enable static vim on peripheral"
    default n

config NICE_OLED_VIP_MARCOS
bool "Enable static vim_marcos on peripheral"
    default n

config NICE_OLED_WIDGET_MASTER_TEST
    bool "Enable test widget on master"
    default n

config NICE_OLED_WIDGET_PERIPHERAL_TEST
    bool "Enable test widget on peripheral"
    default n

config NICE_OLED_WIDGET_DONGLE_TEST
    bool "Enable test widget on dongle"
    default n

config NICE_VIEW_WIDGET_STATUS
    select LV_USE_LABEL
    select LV_USE_IMG
    select LV_USE_CANVAS
    select LV_USE_ANIMIMG
    select LV_USE_ANIMATION

config NICE_VIEW_WIDGET_INVERTED
    bool "Invert display colors"

if !ZMK_SPLIT || ZMK_SPLIT_ROLE_CENTRAL

config NICE_VIEW_WIDGET_STATUS
    select ZMK_WPM

### NICE OLED WIDGET LAYER RGB TODO:
config NICE_OLED_WIDGET_LAYER_RGB
    bool "Enable layer rgb widget"
    default n

endif # !ZMK_SPLIT || ZMK_SPLIT_ROLE_CENTRAL

endif # SHIELD_NICE_OLED
endif # NICE_EPAPER_ON

if SHIELD_NICE_OLED || SHIELD_NICE_EPAPER

config ZMK_DISPLAY
    default y

config LV_FONT_MONTSERRAT_14
    default y

config LV_FONT_MONTSERRAT_16
    default y

config LV_FONT_MONTSERRAT_18
    default y

config LV_FONT_MONTSERRAT_20
    default y

config LV_FONT_MONTSERRAT_22
    default y

config LV_FONT_MONTSERRAT_24
    default y

config LV_FONT_MONTSERRAT_26
    default y

config LV_FONT_MONTSERRAT_28
    default y

config LV_FONT_MONTSERRAT_30
    default y

config LV_FONT_MONTSERRAT_32
    default y

config LV_FONT_MONTSERRAT_34
    default y

config LV_FONT_MONTSERRAT_36
    default y

config LV_FONT_MONTSERRAT_38
    default y

config LV_FONT_MONTSERRAT_40
    default y

config LV_FONT_MONTSERRAT_42
    default y

config LV_FONT_MONTSERRAT_44
    default y

config LV_FONT_MONTSERRAT_46
    default y

config LV_FONT_MONTSERRAT_48
    default y

config LV_FONT_MONTSERRAT_50
    default y

config LV_FONT_MONTSERRAT_52
    default y

config LV_FONT_MONTSERRAT_54
    default y

config LV_FONT_MONTSERRAT_56
    default y

config LV_FONT_MONTSERRAT_58
    default y

config LV_FONT_MONTSERRAT_60
    default y

config LV_FONT_MONTSERRAT_62
    default y

config LV_FONT_MONTSERRAT_64
    default y

config LV_FONT_MONTSERRAT_66
    default y

config LV_FONT_MONTSERRAT_68
    default y

config LV_FONT_MONTSERRAT_70
    default y

config LV_FONT_MONTSERRAT_72
    default y

config LV_FONT_MONTSERRAT_74
    default y

config LV_FONT_MONTSERRAT_76
    default y

config LV_FONT_MONTSERRAT_78
    default y

config LV_FONT_MONTSERRAT_80
    default y

config LV_FONT_MONTSERRAT_82
    default y

config LV_FONT_MONTSERRAT_84
    default y

config LV_FONT_MONTSERRAT_86
    default y

config LV_FONT_MONTSERRAT_88
    default y

config LV_FONT_MONTSERRAT_90
    default y

config LV_FONT_MONTSERRAT_92
    default y

config LV_FONT_MONTSERRAT_94
    default y

config LV_FONT_MONTSERRAT_96
    default y

config LV_FONT_MONTSERRAT_98
    default y

config LV_FONT_MONTSERRAT_100
    default y

config LV_FONT_MONTSERRAT_102
    default y

config LV_FONT_MONTSERRAT_104
    default y

config LV_FONT_MONTSERRAT_106
    default y

config LV_FONT_MONTSERRAT_108
    default y

config LV_FONT_MONTSERRAT_110
    default y

config LV_FONT_MONTSERRAT_112
    default y

config LV_FONT_MONTSERRAT_114
    default y

config LV_FONT_MONTSERRAT_116
    default y

config LV_FONT_MONTSERRAT_118
    default y

config LV_FONT_MONTSERRAT_120
    default y

config LV_FONT_MONTSERRAT_122
    default y

config LV_FONT_MONTSERRAT_124
    default y

config LV_FONT_MONTSERRAT_126
    default y

config LV_FONT_MONTSERRAT_128
    default y

config LV_FONT_MONTSERRAT_130
    default y

config LV_FONT_MONTSERRAT_132
    default y

config LV_FONT_MONTSERRAT_134
    default y

config LV_FONT_MONTSERRAT_136
    default y

config LV_FONT_MONTSERRAT_138
    default y

config LV_FONT_MONTSERRAT_140
    default y

config LV_FONT_MONTSERRAT_142
    default y

config LV_FONT_MONTSERRAT_144
    default y

config LV_FONT_MONTSERRAT_146
    default y

config LV_FONT_MONTSERRAT_148
    default y

config LV_FONT_MONTSERRAT_150
    default y

config LV_FONT_MONTSERRAT_152
    default y

config LV_FONT_MONTSERRAT_154
    default y

config LV_FONT_MONTSERRAT_156
    default y

config LV_FONT_MONTSERRAT_158
    default y

config LV_FONT_MONTSERRAT_160
    default y

config LV_FONT_MONTSERRAT_162
    default y

config LV_FONT_MONTSERRAT_164
    default y

config LV_FONT_MONTSERRAT_166
    default y

config LV_FONT_MONTSERRAT_168
    default y

config LV_FONT_MONTSERRAT_170
    default y

config LV_FONT_MONTSERRAT_172
    default y

config LV_FONT_MONTSERRAT_174
    default y

config LV_FONT_MONTSERRAT_176
    default y

config LV_FONT_MONTSERRAT_178
    default y

config LV_FONT_MONTSERRAT_180
    default y

config LV_FONT_MONTSERRAT_182
    default y

config LV_FONT_MONTSERRAT_184
    default y

config LV_FONT_MONTSERRAT_186
    default y

config LV_FONT_MONTSERRAT_188
    default y

config LV_FONT_MONTSERRAT_190
    default y

config LV_FONT_MONTSERRAT_192
    default y

config LV_FONT_MONTSERRAT_194
    default y

config LV_FONT_MONTSERRAT_196
    default y

config LV_FONT_MONTSERRAT_198
    default y

config LV_FONT_MONTSERRAT_200
    default y

endif # SHIELD_NICE_OLED || SHIELD_NICE_EPAPER

if NICE_EPAPER_ON
rsource "nice_epaper/Kconfig.defconfig"
endif # NICE_EPAPER_ON
```
